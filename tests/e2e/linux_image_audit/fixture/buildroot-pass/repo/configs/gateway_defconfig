## tests/e2e/linux_image_audit/fixture/buildroot-pass/repo/configs/gateway_defconfig
```kconfig
BR2_aarch64=y
BR2_TOOLCHAIN_EXTERNAL=y
BR2_INIT_SYSTEMD=y
BR2_ROOTFS_OVERLAY="$(BR2_EXTERNAL_GATEWAY_PATH)/board/gateway/rootfs-overlay"
BR2_TARGET_GENERIC_HOSTNAME="gateway"
BR2_TARGET_ROOTFS_SQUASHFS=y
BR2_TARGET_UBOOT=y
BR2_TARGET_UBOOT_BOARD_DEFCONFIG="qemu_arm64"
BR2_LINUX_KERNEL=y
BR2_LINUX_KERNEL_USE_ARCH_DEFAULT_CONFIG=y
BR2_REPRODUCIBLE=y
```

## tests/e2e/linux_image_audit/fixture/yocto-fail/repo/conf/distro/appliance.conf
```bitbake
require conf/distro/poky.conf
DISTRO = "appliance"
DISTRO_NAME = "Appliance"
DISTRO_VERSION = "2.1.0"
INIT_MANAGER = "systemd"
DISTRO_FEATURES:append = " rauc"
```

## tests/e2e/linux_image_audit/fixture/yocto-pass/repo/conf/layer.conf
```bitbake
BBPATH .= ":${LAYERDIR}"
BBFILES += "${LAYERDIR}/recipes-*/*/*.bb ${LAYERDIR}/recipes-*/*/*.bbappend"
BBFILE_COLLECTIONS += "appliance"
BBFILE_PATTERN_appliance = "^${LAYERDIR}/"
BBFILE_PRIORITY_appliance = "10"
LAYERDEPENDS_appliance = "core rauc"
LAYERSERIES_COMPAT_appliance = "scarthgap"
```
